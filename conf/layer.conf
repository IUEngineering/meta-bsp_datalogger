## conf/layer.conf
```bitbake
# We have a conf and classes directory, add to BBPATH
BBPATH .= ":${LAYERDIR}"
MACHINE ??= 'imx6ull-datalogger'

# We have recipes-* directories, add to BBFILES
BBFILES += "${LAYERDIR}/recipes-*/*/*.bb \
            ${LAYERDIR}/recipes-*/*/*.bbappend"

BBFILE_COLLECTIONS += "meta-bsp_datalogger"
BBFILE_PATTERN_meta-bsp_datalogger = "^${LAYERDIR}/"
BBFILE_PRIORITY_meta-bsp_datalogger = "10"

LAYERDEPENDS_meta-bsp_datalogger = "core"
LAYERSERIES_COMPAT_meta-bsp_datalogger = "scarthgap"

# To expand SD on first boot
CORE_IMAGE_EXTRA_INSTALL += "e2fsprogs-resize2fs"

# Very important for SDMA drivers
CORE_IMAGE_EXTRA_INSTALL += "firmware-imx-sdma-imx6q" 

CORE_IMAGE_EXTRA_INSTALL += "i2c-tools"
CORE_IMAGE_EXTRA_INSTALL += "alsa-utils"
CORE_IMAGE_EXTRA_INSTALL += "nano"
CORE_IMAGE_EXTRA_INSTALL += "kernel-modules"
CORE_IMAGE_EXTRA_INSTALL += "rsync"
CORE_IMAGE_EXTRA_INSTALL += "wvdial"
CORE_IMAGE_EXTRA_INSTALL += "usbutils"

# Thommy additions:
CORE_IMAGE_EXTRA_INSTALL += "htop"
CORE_IMAGE_EXTRA_INSTALL += "stress-ng"
# Bart-Jan additions:
CORE_IMAGE_EXTRA_INSTALL += "screen"
CORE_IMAGE_EXTRA_INSTALL += "curl"
CORE_IMAGE_EXTRA_INSTALL += "iperf3"
CORE_IMAGE_EXTRA_INSTALL += "git"
CORE_IMAGE_EXTRA_INSTALL += "net-tools"
CORE_IMAGE_EXTRA_INSTALL += "nftables"
# JDB additions:
CORE_IMAGE_EXTRA_INSTALL += "gpsd"
CORE_IMAGE_EXTRA_INSTALL += "minicom"
CORE_IMAGE_EXTRA_INSTALL += "netcat"
CORE_IMAGE_EXTRA_INSTALL += "tcpdump"
# Modem
CORE_IMAGE_EXTRA_INSTALL += "ppp"
KERNEL_CONFIG_FRAGMENTS += "ppp.cfg"

# C/C++ build tools
CORE_IMAGE_EXTRA_INSTALL += "gcc gcc-symlinks g++ g++-symlinks"
CORE_IMAGE_EXTRA_INSTALL += "libgcc libstdc++"
CORE_IMAGE_EXTRA_INSTALL += "make"
CORE_IMAGE_EXTRA_INSTALL += "cmake"
CORE_IMAGE_EXTRA_INSTALL += "binutils binutils-symlinks"

CORE_IMAGE_EXTRA_INSTALL += "\
    packagegroup-fsl-tools-audio \
    pulseaudio \
    hostapd \
    ethtool \
    iperf3 \
    tcpdump \
    iw \
    kernel-module-60-backports \
	60-radio-firmware-usb-usb \
	summit-supplicant \
	summit-supplicant-libs \
	summit-adaptive-ww \
	summit-networkmanager \
	summit-networkmanager-nmcli \
    "

PREFERRED_RPROVIDER_wpa-supplicant = "summit-supplicant"
PREFERRED_RPROVIDER_wpa-supplicant-cli = "summit-supplicant"
PREFERRED_RPROVIDER_wpa-supplicant-passphrase = "summit-supplicant"
PREFERRED_PROVIDER_wpa-supplicant = "summit-supplicant"
PREFERRED_RPROVIDER_wpa-supplicant-lib = "summit-supplicant"
PREFERRED_RPROVIDER_hostapd = "summit-hostapd"

PREFERRED_RPROVIDER_wireless-regdb-static = "60-radio-firmware-usb-usb"
```

## conf/machine/imx6ull-datalogger.conf
```bitbake
require conf/machine/imx6ullevk.conf
MACHINEOVERRIDES_EXTENDER_imx6ull-datalogger = "mx6ull"

KERNEL_DEVICETREE += "nxp/imx/imx6ull-datalogger.dtb"

IMAGE_BOOT_FILES = "zImage imx6ull-datalogger.dtb"
```
